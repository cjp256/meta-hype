## conf/distro/oe-hype-dom0.conf
```bitbake
DISTRO = "oe-hype-dom0"
DISTROOVERRIDES = ""

DISTRO_FEATURES_append = " tpm txt usb3 xen opengl aufs "
```

## conf/distro/oe-hype-guest-xengt.conf
```bitbake
DISTRO = "oe-hype-guest-xengt"
DISTROOVERRIDES = ""

DISTRO_FEATURES_append = " tpm txt usb3 xen opengl aufs xengt x11 alsa wifi "
LICENSE_FLAGS_WHITELIST = "commercial"
```

## conf/distro/oe-hype-guest.conf
```bitbake
DISTRO = "oe-hype-guest"
DISTROOVERRIDES = ""

DISTRO_FEATURES_append = " tpm txt usb3 xen opengl aufs x11 "
```

## conf/distro/oe-hype.conf
```bitbake
DISTRO = "oe-hype"
DISTROOVERRIDES = ""

DISTRO_FEATURES_append = " tpm txt usb3 xen opengl "
```

## conf/distro/poky-hype.conf
```bitbake
require conf/distro/include/poky-floating-revisions.inc
require conf/distro/poky.conf

DISTRO = "poky-hype"
DISTROOVERRIDES = ""

DISTRO_FEATURES_append = " tpm txt usb3 "
```

## conf/layer.conf
```bitbake
BBPATH := "${BBPATH}:${LAYERDIR}"

BBFILES := "${BBFILES} \
            ${LAYERDIR}/recipes-*/*/*.bb \
            ${LAYERDIR}/recipes-*/*/*.bbappend \
            "

BBFILE_COLLECTIONS += "hype"
BBFILE_PATTERN_hype := "^${LAYERDIR}/"
BBFILE_PRIORITY_hype = "5"
```
